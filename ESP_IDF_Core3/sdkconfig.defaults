## ESP_IDF_Core3/sdkconfig.defaults
```kconfig
# ESP32-S3 Configuration
CONFIG_IDF_TARGET="esp32s3"

# PSRAM Configuration - DISABLED (M5Stack CoreS3 PSRAM connection issue)
CONFIG_SPIRAM=n

# Camera Configuration
CONFIG_CAMERA_CORE0=y
CONFIG_CAMERA_CORE1=n
CONFIG_CAMERA_DMA_BUFFER_SIZE_MAX=32768

# FAT Filesystem
CONFIG_FATFS_LFN_HEAP=y
CONFIG_FATFS_MAX_LFN=255

# Partition Table
CONFIG_PARTITION_TABLE_CUSTOM=y
CONFIG_PARTITION_TABLE_CUSTOM_FILENAME="partitions.csv"
CONFIG_PARTITION_TABLE_FILENAME="partitions.csv"

# Flash size
CONFIG_ESPTOOLPY_FLASHSIZE_16MB=y
CONFIG_ESPTOOLPY_FLASHSIZE="16MB"

# Main task stack size
CONFIG_ESP_MAIN_TASK_STACK_SIZE=8192

# FreeRTOS
CONFIG_FREERTOS_HZ=1000
CONFIG_FREERTOS_UNICORE=n

# ESP32S3-Specific
CONFIG_ESP_DEFAULT_CPU_FREQ_MHZ_240=y

# Compiler options
CONFIG_COMPILER_OPTIMIZATION_PERF=y

# I2C Driver Configuration - Use new driver (driver_ng) only
CONFIG_I2C_ENABLE_LEGACY=n

# LVGL Image Decoder Configuration
CONFIG_LV_USE_TJPGD=y
CONFIG_LV_USE_LIBJPEG_TURBO=n
```
